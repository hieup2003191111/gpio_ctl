## app/Config.in
```kconfig
config BR2_PACKAGE_APP
    bool "app"
    help
      Simple LED control app using gpio_ctl driver.
```

## driver/Kconfig
```kconfig
config GPIO_CTL
    bool "Demo GPIO LED Control Driver"
    depends on GPIOLIB
    help
      Simple platform driver to control LED via GPIO.
```
